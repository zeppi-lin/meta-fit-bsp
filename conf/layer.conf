## conf/layer.conf
```bitbake
# We have a conf and classes directory, add to BBPATH
BBPATH .= ":${LAYERDIR}"

# We have a packages directory, add to BBFILES
BBFILES += "${LAYERDIR}/recipes-*/*/*.bb \
            ${LAYERDIR}/recipes-*/*/*.bbappend"

BBFILE_COLLECTIONS += "meta-fit"
BBFILE_PATTERN_meta-fit = "^${LAYERDIR}/"
BBFILE_PRIORITY_meta-fit = "6"

#LAYERDEPENDS_fit = "meta-freescale-3rdparty"
#LAYERVERSION_fit = "1"

LAYERSERIES_COMPAT_meta-fit = "sumo"
```

## conf/machine/fit-v2.conf
```bitbake
#@TYPE: Machine
#@NAME: Fit V2 machine
#@SOC: i.MX6Q
#@DESCRIPTION: We're not sure
#@MAINTAINER: We're not sure

MACHINEOVERRIDES =. "mx6:mx6q:"

require conf/machine/include/imx6sabresd-common.inc

KERNEL_DEVICETREE = "imx6q-sabresd.dtb imx6q-sabresd-ldo.dtb imx6q-sabresd-hdcp.dtb \
                     imx6q-sabresd-enetirq.dtb imx6q-sabresd-btwifi.dtb"

MACHINE_FEATURES_append = " optee"

UBOOT_CONFIG ??= "${@bb.utils.contains('COMBINED_FEATURES', 'optee', 'sd-optee', 'sd', d)}"
UBOOT_CONFIG[sd] = "mx6qsabresd_config,sdcard"
UBOOT_CONFIG[sata] = "mx6qsabresd_sata_config"
UBOOT_CONFIG[mfgtool] = "mx6qsabresd_config"
UBOOT_CONFIG[sd-optee] = "mx6qsabresd_optee_config,sdcard"

OPTEE_BIN_EXT = "6qsdb"

PREFERRED_PROVIDER_virtual/kernel_fit-v2 = "linux-imx"
```

## conf/machine/fv2qdeva.conf
```bitbake
#@TYPE: Machine
#@NAME: Fit V2 Quad Dev Board
#@SOC: i.MX6Q
#@DESCRIPTION: We're not sure
#@MAINTAINER: We're not sure

MACHINEOVERRIDES =. "mx6:mx6q:"

require conf/machine/include/imx6sabresd-common.inc

KERNEL_DEVICETREE = "fv2q-dev-a.dtb"
#KERNEL_DEVICETREE = "fv2q-dev-a.dtb imx6q-sabresd.dtb imx6q-sabresd-ldo.dtb imx6q-sabresd-hdcp.dtb \
#                     imx6q-sabresd-enetirq.dtb imx6q-sabresd-btwifi.dtb"

MACHINE_FEATURES_remove = "optee"

# note: this is what bb.utils.contains does..
#def contains(variable, checkvalues, truevalue, falsevalue, d):
#    """Check if a variable contains all the values specified.
#      Arguments:
#        variable -- the variable name. This will be fetched and expanded (using
#          d.getVar(variable, True)) and then split into a set().
#        checkvalues -- if this is a string it is split on whitespace into a set(),
#          otherwise coerced directly into a set().
#        truevalue -- the value to return if checkvalues is a subset of variable.
#        falsevalue -- the value to return if variable is empty or if checkvalues is
#          not a subset of variable.
#        d -- the data store.
#    """
UBOOT_CONFIG ??= "${@bb.utils.contains('COMBINED_FEATURES', 'optee', 'sd-optee', 'sd', d)}"
UBOOT_CONFIG[sd] = "fv2qdeva_config,sdcard"
#UBOOT_CONFIG[sd] = "mx6qsabresd_config,sdcard"
#UBOOT_CONFIG[sata] = "mx6qsabresd_sata_config"
UBOOT_CONFIG[mfgtool] = "fv2qdeva_config"
#UBOOT_CONFIG[mfgtool] = "mx6qsabresd_config"
#UBOOT_CONFIG[sd-optee] = "mx6qsabresd_optee_config,sdcard"

#OPTEE_BIN_EXT = "6qsdb"

PREFERRED_PROVIDER_virtual/kernel_fit-v2 = "linux-imx"
PREFERRED_PROVIDER_virtual/bootloader_fit-v2 = "u-boot-imx"
```
